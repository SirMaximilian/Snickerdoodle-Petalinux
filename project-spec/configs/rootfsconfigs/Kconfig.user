## project-spec/configs/rootfsconfigs/Kconfig.user
```kconfig
menu "user packages " 
config gpio-demo  
	 bool "gpio-demo"
	 help
	
config peekpoke  
	 bool "peekpoke"
	 help
	
config wifi-fw  
	 bool "wifi-fw"
	 help
	
endmenu
```

## rootfs.wks
```
# Description: Creates a partitioned SD card image. Boot files
# are located in the first vfat partition. Rootfs will be in second ext4 partition.

part /boot --source bootimg-partition --use-label --fstype=vfat --label boot --active --align 4 --fixed-size 256M
part /     --source rootfs            --use-label --fstype=ext4 --label root          --align 4 --fixed-size 4G
```
